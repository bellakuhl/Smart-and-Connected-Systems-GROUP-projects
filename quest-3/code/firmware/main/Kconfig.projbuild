## quest-3/code/firmware/main/Kconfig.projbuild
```kconfig
menu "Wearable Network Config"
    config WIFI_SSID
        string "WiFi SSID"
        default "Group_15"
        help
            SSID (network name) to connect to.

    config WIFI_PASSPHRASE
        string "WiFi Passphrase"
        default "smart-systems"
        help
            Wifi passphrase

    config PI_IP_ADDR
        string "PI IP Addr"
        default "192.168.1.108"
        help
            The IP address of the client running the nodejs webserver
    
    config PI_PORT
        int "PI Port"
        default 8080
        help
            Port to send UDP messages to.

    config UDP_LISTEN_PORT
        int "UDP Listen Port"
        default 8080
        help
            The local port to listen for UDP messages on.
endmenu
```

## quest-5/code/security_hub/main/Kconfig.projbuild
```kconfig
menu "Security Hub Config"
    config WIFI_SSID
        string "WiFi SSID"
        default "Group_15"
        help
            SSID (network name) to connect to.

    config WIFI_PASSPHRASE
        string "WiFi Passphrase"
        default "smart-systems"
        help
            Wifi passphrase

    config SERVER_HOST
        string "Server Host"
        default "192.168.1.108"
        help
            The IP address of the client running the nodejs webserver
    
    config SERVER_PORT
        int "Server Port"
        default 8080
        help
            Port to send UDP messages to.

    config SERVER_USERNAME
        string "Username"
        default "sechub"
        help
            Username the security hub uses to make reuqests to the server

    config SERVER_PASSWORD
        string "Password"
        default "sechub1115"
        help
            Password the security hub uses to make reuqests to the server
endmenu
```

## quest-5/code/transmitter/main/Kconfig.projbuild
```kconfig
menu "Fob Config"
    config FOB_ID
        int "Fob ID"
        default 0
        help
            Fob ID

    config FOB_CODE
        int "Fob Code"
        default 0
        help
            Fob Code
endmenu
```

## quest-6/code/firmware/main/Kconfig.projbuild
```kconfig
menu "Crawler Config"
    config WIFI_SSID
        string "WiFi SSID"
        default "Group_15"
        help
            SSID (network name) to connect to.

    config WIFI_PASSPHRASE
        string "WiFi Passphrase"
        default "smart-systems"
        help
            Wifi passphrase

    config SERVER_HOST
        string "Server Host"
        default "192.168.1.108"
        help
            The IP address of the client running the nodejs webserver

    config SERVER_UDP_PORT
        int "Server UDP Port"
        default 9000
        help
            Port to send UDP messages to.

    config SERVER_HTTP_PORT
        int "Server Port"
        default 8000
        help
            Port to send UDP messages to.

    config CRAWLER_UDP_RECV_PORT
        int "UDP Recv Port"
        default 9000
        help
            The port on which to receive UDP messages.

    config CRAWLER_USERNAME
        string "Crawler ID"
        default "crawler15"
        help
            The username the crawler uses to send messages to the server.

    config CRAWLER_PASSWORD
        string "Crawler Password"
        default "team15lastquest"
        help
            The password the crawler uses to send messages to the server.
endmenu
```
